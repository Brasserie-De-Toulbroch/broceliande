## package/bard/Config.in
```kconfig
config BR2_PACKAGE_BARD
	bool "bard"
	help
	  Bard

	  https://github.com/Brasserie-De-Toulbroch/bard
```

## package/druid/Config.in
```kconfig
config BR2_PACKAGE_DRUID
	bool "druid"
	depends on BR2_INSTALL_LIBSTDCPP
	depends on BR2_PACKAGE_QT5BASE
	depends on BR2_PACKAGE_QT5BASE_GUI
	depends on BR2_PACKAGE_QT5BASE_WIDGETS
	depends on BR2_PACKAGE_QWT
	depends on BR2_PACKAGE_BARD
	help
	  Druid

	  https://github.com/Brasserie-De-Toulbroch/druid
```

## package/idesk/Config.in
```kconfig
config BR2_PACKAGE_IDESK
	bool "idesk"
	depends on BR2_PACKAGE_IMLIB2
	help
	  idesk
```
